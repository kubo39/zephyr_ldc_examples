## CMakeLists.txt
```
# SPDX-License-Identifier: Apache-2.0

cmake_minimum_required(VERSION 3.20.0)
find_package(Zephyr REQUIRED HINTS $ENV{ZEPHYR_BASE})
project(ldc_hello_world)

target_sources(app PRIVATE src/main.c)

if(${ARCH} STREQUAL "posix" OR ${ARCH} STREQUAL "x86")
    set(ldc_target i686-unknown-none-newlibeabi)
elseif(CONFIG_CPU_CORTEX_M)
    if(CONFIG_CPU_CORTEX_M3)
        set(ldc_target thumbv7em-unknown-none-newlibeabi)
    else()
        message(FATAL_ERROR "Unknown Cortex-M target")
    endif()
elseif(CONFIG_RISCV)
    if(CONFIG_RISCV_ISA_RV32I)
        set(ldc_target riscv32-unknown-newlib-elf)
    else()
        message(FATAL_ERROR "Unsupported riscv ISA")
    endif()
else()
    message(FATAL_ERROR "ARCH ${ARCH} not supported")
endif()

include(ExternalProject)
set(ldc_src_dir ${CMAKE_CURRENT_SOURCE_DIR})
ExternalProject_Add(
    ldc_project
    PREFIX  ${CMAKE_CURRENT_BINARY_DIR}
    SOURCE_DIR  ${ldc_src_dir}
    BUILD_IN_SOURCE 1
    BUILD_ALWAYS    1
    CONFIGURE_COMMAND   ""
    BUILD_COMMAND
        dub
        build
        -f
        -b release
        --compiler=ldc2
        --arch=${ldc_target}
    INSTALL_COMMAND ""
    BUILD_BYPRODUCTS    ${ldc_src_dir}/lib/libhelloworld.a
)

add_library(ldc_lib STATIC IMPORTED GLOBAL)
add_dependencies(
    ldc_lib
    ldc_project
)
set_target_properties(ldc_lib PROPERTIES IMPORTED_LOCATION ${ldc_src_dir}/lib/libhelloworld.a)
target_link_libraries(app PUBLIC ldc_lib)
```

## sample.yaml
```
sample:
  description: hello world
  name: helloworld
common:
  build_only: true
  platform_allow:
    - qemu_cortex_m3
tests:
  app.default: {}
```

## prj.conf
```kconfig
CONFIG_NEWLIB_LIBC=y
CONFIG_POSIX_API=y
CONFIG_MAIN_STACK_SIZE=2048
CONFIG_LINKER_ORPHAN_SECTION_PLACE=y
```

## src/main.c
```c
extern void d_main(void);

int main(void) {
    d_main();
    return 0;
}
```
