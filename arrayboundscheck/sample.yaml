## arrayboundscheck/sample.yaml
```yaml
sample:
  description: arrayboundscheck example
  name: arrayboundscheck
common:
  build_only: true
  platform_allow:
    - qemu_cortex_m3
tests:
  app.default: {}
```

## eventfd/sample.yaml
```yaml
sample:
  description: eventfd example
  name: eventfd
common:
  build_only: true
  platform_allow:
    - qemu_cortex_m3
tests:
  app.default: {}
```
