## CMakeLists.txt
```
# SPDX-License-Identifier: Apache-2.0

cmake_minimum_required(VERSION 3.20.0)
find_package(Zephyr REQUIRED HINTS $ENV{ZEPHYR_BASE})
project(ldc_gettimeofday)

target_sources(app PRIVATE src/main.c)

if(${ARCH} STREQUAL "posix" OR ${ARCH} STREQUAL "x86")
    set(ldc_target i686-unknown-none-newlibeabi)
elseif(CONFIG_CPU_CORTEX_M)
    if(CONFIG_CPU_CORTEX_M3)
        set(ldc_target thumbv7em-unknown-none-newlibeabi)
    else()
        message(FATAL_ERROR "Unknown Cortex-M target")
    endif()
else()
    message(FATAL_ERROR "ARCH ${ARCH} not supported")
endif()

include(ExternalProject)
set(ldc_src_dir ${CMAKE_CURRENT_SOURCE_DIR})
ExternalProject_Add(
    ldc_project
    PREFIX  ${CMAKE_CURRENT_BINARY_DIR}
    SOURCE_DIR  ${ldc_src_dir}
    BUILD_IN_SOURCE 1
    BUILD_ALWAYS    1
    CONFIGURE_COMMAND   ""
    BUILD_COMMAND
        dub
        build
        -f
        -b debug
        --compiler=ldc2
        --arch=${ldc_target}
    INSTALL_COMMAND ""
    BUILD_BYPRODUCTS    ${ldc_src_dir}/lib/libgettimeofday_d.a
)

add_library(ldc_lib STATIC IMPORTED GLOBAL)
add_dependencies(
    ldc_lib
    ldc_project
)
set_target_properties(ldc_lib PROPERTIES IMPORTED_LOCATION ${ldc_src_dir}/lib/libgettimeofday_d.a)
target_link_libraries(app PUBLIC ldc_lib)
```

## prj.conf
```kconfig
# General config
CONFIG_MAIN_STACK_SIZE=2048
CONFIG_NEWLIB_LIBC=y
CONFIG_POSIX_API=y
CONFIG_LINKER_ORPHAN_SECTION_PLACE=y
CONFIG_SNTP=y
CONFIG_NET_CONFIG_CLOCK_SNTP_INIT=y
CONFIG_NET_CONFIG_SNTP_INIT_SERVER="time.nist.gov"
CONFIG_NET_CONFIG_SNTP_INIT_RESYNC=y

# Networking config
CONFIG_NETWORKING=y
CONFIG_NET_IPV4=y
CONFIG_NET_IPV6=y
CONFIG_NET_TCP=y
CONFIG_NET_SOCKETS=y

CONFIG_DNS_RESOLVER=y
CONFIG_DNS_SERVER_IP_ADDRESSES=y
CONFIG_DNS_SERVER1="192.0.2.2"

# Network driver config
CONFIG_TEST_RANDOM_GENERATOR=y

# Network address config
CONFIG_NET_CONFIG_SETTINGS=y
CONFIG_NET_CONFIG_NEED_IPV4=y
CONFIG_NET_CONFIG_MY_IPV4_ADDR="192.0.2.1"
CONFIG_NET_CONFIG_PEER_IPV4_ADDR="192.0.2.2"
CONFIG_NET_CONFIG_MY_IPV4_GW="192.0.2.2"

# Network debug config
CONFIG_NET_LOG=y
```

## ldc2.conf
```kconfig
default:
{
    switches = [
        "--betterC",
        "--float-abi=soft",
        "--relocation-model=static",
        "--defaultlib="
    ];
    post-switches = [
        "-I%%ldcbinarypath%%/../import",
    ];
    lib-dirs = [];
}
```

## src/main.c
```c
extern int d_main();

int main() {
    return d_main();
}
```
